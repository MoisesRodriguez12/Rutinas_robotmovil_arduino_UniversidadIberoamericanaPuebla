#include <Servo.h>
#include <Adafruit_NeoPixel.h>
#include "U8glib.h"
//---------------------------PINES ASIGNADOS---------------------------------------
//PANTALLA OLED--------
U8GLIB_SSD1306_128X64 u8g(U8G_I2C_OPT_DEV_0 | U8G_I2C_OPT_NO_ACK | U8G_I2C_OPT_FAST);
#define BUTTON_SELECT_PIN A7// pin for SELECT button
// 'item_sel_outline', 128x21px
const unsigned char bitmap_item_sel_outline [] PROGMEM = {
  0x1f, 0xff, 0xff, 0xff, 0xff, 0xff, 0xff, 0xff, 0xff, 0xff, 0xff, 0xff, 0xff, 0xff, 0xff, 0xc0, 
  0x20, 0x00, 0x00, 0x00, 0x00, 0x00, 0x00, 0x00, 0x00, 0x00, 0x00, 0x00, 0x00, 0x00, 0x00, 0x20, 
  0x40, 0x00, 0x00, 0x00, 0x00, 0x00, 0x00, 0x00, 0x00, 0x00, 0x00, 0x00, 0x00, 0x00, 0x00, 0x30, 
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  0x1f, 0xff, 0xff, 0xff, 0xff, 0xff, 0xff, 0xff, 0xff, 0xff, 0xff, 0xff, 0xff, 0xff, 0xff, 0xc0
};
const unsigned char bitmap_scrollbar_background [] PROGMEM = {
  0x00, 0x02, 0x00, 0x02, 0x00, 0x02, 0x00, 0x02, 0x00, 0x02, 0x00, 0x02, 0x00, 0x02, 0x00, 0x02, 
  0x00, 0x02, 0x00, 0x02, 0x00, 0x02, 0x00, 0x02, 0x00, 0x02, 0x00, 0x02, 0x00, 0x02, 0x00, 0x02, 
  0x00, 0x02, 0x00, 0x02, 0x00, 0x02, 0x00, 0x02, 0x00, 0x02, 0x00, 0x02, 0x00, 0x02, 0x00, 0x02, 
  0x00, 0x02, 0x00, 0x02, 0x00, 0x02, 0x00, 0x02, 0x00, 0x02, 0x00, 0x02, 0x00, 0x02, 0x00, 0x00
};
const unsigned char icono_regla [] PROGMEM = {
	0x1f, 0xff, 0xff, 0xff, 0xff, 0xff, 0xff, 0xff, 0xff, 0xff, 0xff, 0xf8, 0x20, 0x18, 0x07, 0x00, 
	0xc0, 0x38, 0x06, 0x01, 0xc0, 0x30, 0x1c, 0x04, 0x40, 0x18, 0x07, 0x00, 0xc0, 0x38, 0x06, 0x01, 
	0xc0, 0x30, 0x1c, 0x02, 0xc0, 0x18, 0x07, 0x00, 0xc0, 0x38, 0x06, 0x01, 0xc0, 0x30, 0x1c, 0x01, 
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	0xff, 0xff, 0xff, 0xfc, 0x1f, 0xff, 0xff, 0xff, 0xff, 0xff, 0xff, 0xff, 0xff, 0xff, 0xff, 0xf8
};
const unsigned char icono_velocidad [] PROGMEM = {
	0x00, 0x00, 0x00, 0x00, 0x00, 0x00, 0x00, 0x00, 0x00, 0x00, 0x00, 0x00, 0x00, 0x00, 0x00, 0x00, 
	0x00, 0x00, 0x00, 0x00, 0x00, 0x00, 0x00, 0x00, 0x00, 0x00, 0x00, 0x00, 0x00, 0x00, 0x00, 0x00, 
	0x00, 0x00, 0x00, 0x00, 0x00, 0x00, 0x00, 0x00, 0x00, 0x00, 0x00, 0x00, 0x00, 0x00, 0x00, 0x00, 
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	0x00, 0x00, 0x00, 0x00, 0x00, 0x00, 0x00, 0x00, 0x00, 0x00, 0x00, 0x00, 0x00, 0x00, 0x00, 0x00
};
const unsigned char icono_bocina [] PROGMEM = {
	0x00, 0x00, 0x00, 0x00, 0x00, 0x00, 0x00, 0x00, 0x00, 0x00, 0x00, 0x00, 0x00, 0x00, 0x00, 0x00, 
	0x00, 0x00, 0x00, 0x00, 0x00, 0x00, 0x00, 0x00, 0x00, 0x00, 0x00, 0x00, 0x00, 0x00, 0x00, 0x00, 
	0x00, 0x00, 0x00, 0x00, 0x00, 0x00, 0x00, 0x00, 0x00, 0x00, 0x00, 0x00, 0x00, 0x00, 0x00, 0x00, 
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	0x00, 0x00, 0x00, 0x00, 0x00, 0x00, 0x00, 0x00, 0x00, 0x00, 0x00, 0x00, 0x00, 0x00, 0x00, 0x00
};
const unsigned char icono_reloj [] PROGMEM = {
	0x00, 0x00, 0x00, 0x00, 0x00, 0x1f, 0xf8, 0x00, 0x00, 0x00, 0x00, 0x00, 0x00, 0x00, 0x00, 0x00, 
	0x00, 0xff, 0xff, 0x00, 0x00, 0x00, 0x00, 0x00, 0x00, 0x00, 0x00, 0x00, 0x03, 0xc0, 0x07, 0xc0, 
	0x00, 0x00, 0x00, 0x00, 0x00, 0x00, 0x00, 0x00, 0x07, 0x01, 0x80, 0x60, 0x00, 0x00, 0x00, 0x00, 
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	0x00, 0x00, 0x00, 0x00, 0x00, 0x00, 0x00, 0x00, 0x00, 0x1f, 0xfc, 0x00, 0x00, 0x00, 0x00, 0x00
};
const unsigned char icono_angulo [] PROGMEM = {
	0x00, 0x00, 0x00, 0x00, 0x00, 0x00, 0x00, 0x03, 0x80, 0x00, 0x00, 0x00, 0x00, 0x00, 0x00, 0x00, 
	0x00, 0x00, 0x00, 0x07, 0x80, 0x00, 0x00, 0x00, 0x00, 0x00, 0x00, 0x00, 0x00, 0x00, 0x00, 0x0f, 
	0x80, 0x00, 0x00, 0x00, 0x00, 0x00, 0x00, 0x00, 0x00, 0x00, 0x00, 0x1f, 0x00, 0x00, 0x00, 0x00, 
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	0x00, 0x00, 0x00, 0x00, 0x00, 0x00, 0x00, 0x00, 0x00, 0x03, 0x80, 0x00, 0x00, 0x00, 0x00, 0x00
};
// Array of all bitmaps for convenience. (Total bytes used to store images in PROGMEM = 496)
const int iconosallArray_LEN = 6;
const unsigned char* iconos[6] = {
	0,
  icono_regla,
  icono_velocidad,
  icono_bocina,
  icono_reloj,
  icono_angulo
};


// ------------------ end generated bitmaps from image2cpp ---------------------------------
const int NUM_ITEMS = 4; // number of items in the list and also the number of screenshots and screenshots with QR codes (other screens)
const int MAX_ITEM_LENGTH = 20; // maximum characters for the item name
char menu_items [NUM_ITEMS] [MAX_ITEM_LENGTH] = {  // array with item names
  { "PROGRAMA 1" }, // LE PUEDEO CAMBIAR LOS NOMBRES
  { "PROGRAMA 2" }, 
  { "PROGRAMA 3" }, 
  { "PROGRAMA 4" }
 };
int button_select_clicked = 1; // same as above
int button_down_clicked = 1; // same as above

int item_selected = 0; // which item in the menu is selected

int item_sel_previous; // previous item - used in the menu screen to draw the item before the selected one
int item_sel_next; // next item - used in the menu screen to draw next item after the selected one

int current_screen = 0;   // 0 = menu, 1 = screenshot, 2 = qr

int demo_mode = 0; // when demo mode is set to 1, it automatically goes over all the screens, 0 = control menu with buttons
int demo_mode_state = 0; // demo mode state = which screen and menu item to display
int demo_mode_delay = 0; // demo mode delay = used to slow down the screen switching
//BOTONES----------------
  //digital
  //pin 2
  //analog
  #define botA1 A6
  #define botA2 2
  //convercion en digitales
  int BUTTON_DOWN_PIN=0, BUTTON_SELECT = 0;
//MOTORES--------------
  //derecho
    #define pwmD 6
    #define dirD1 13
    #define dirD2 15
  //izquierdo
    #define pwmI 3    
    #define dirI1 16
    #define dirI2 17
  //Velocidad
    int vel = 255; 
//SERVO------------------
  // pin 5 pwm;
  Servo servoMotor;
//LEDS----------------
  //analog
  #define led3 4 
  #define led1 8
  #define led2 7
//POTENCIOMETRO----------
  #define pot A0
  int posicion_pot=0;
  int angulo_servo = 0;
//SENSOR-------------------
  #define trig 12
  #define eco 11
  long distancia;
  int duracion;
//BUZZER----------------------
  #define buzzer_pin 9
  //              Do0 Re1 Mi2 Fa3 Sol4 La5 Si6 
  const int notas [] = {261,294,329,349,392,440,494};
  const int musica [] = {0,0,4,4,5,5,4,3,3,2,2,1,1,0};
  const int tiempos []= {250,250,250,250,250,250,500,250,250,250,250,250,250,500};
//NEOPIXEL-------------------
  #define neopixel_pin  10
  #define num_leds 4 
  Adafruit_NeoPixel strip = Adafruit_NeoPixel(num_leds,neopixel_pin,NEO_GRB + NEO_KHZ800);
  const int rojos [] = {255,0,0,125};
  const int verdes [] = {0,255,0,125};
  const int azules [] ={0,0,255,125};

//VARIABLES GLOBALES--------
  unsigned long contador = 0;
  bool aux = true;
void setup() {
  Serial.begin(9600);
  u8g.setColorIndex(1);  // set the color to white
    // define pins for buttons
    // INPUT_PULLUP means the button is HIGH when not pressed, and LOW when pressed
    // since it´s connected between some pin and GND
    pinMode(botA1, INPUT_PULLUP); // up button
    pinMode(BUTTON_SELECT_PIN, INPUT_PULLUP); // select button
    pinMode(botA2, INPUT_PULLUP); // down button
  //MOTORES
    pinMode(pwmD,OUTPUT);
    pinMode(pwmI,OUTPUT);
    pinMode(dirD1,OUTPUT);
    pinMode(dirD2,OUTPUT);
    pinMode(dirI1,OUTPUT);
    pinMode(dirI2,OUTPUT);
    pinMode(led2, OUTPUT);
  //SERVOMOTOR
    servoMotor.attach(5);
  //BUZZER
    pinMode(buzzer_pin,OUTPUT);
  // SENSOR
    pinMode(trig, OUTPUT);
    pinMode(eco,INPUT);
  //NEOPIXEL
  strip.begin();
  strip.show();
  //POTENCIOMETRO
  pinMode(pot, INPUT);
  // RESET
  attachInterrupt(digitalPinToInterrupt(botA2),reset,RISING);
}
void bluetooth() {
  while (Serial.available()) {
    char Direccion = Serial.read();

    switch (Direccion) {
      case 'U':
        digitalWrite(dirD1, 0);
        digitalWrite(dirD2, 1);
        digitalWrite(dirI1, 1);
        digitalWrite(dirI2, 0);
        for (int i = 0; i <= 200; i++) {
          analogWrite(pwmD, i);
          analogWrite(pwmI, i);
          contador = millis();
          while(millis()<contador +1.5){

          }
        }
        break;
      case 'D':
        digitalWrite(dirD1, 1);
        digitalWrite(dirD2, 0);
        digitalWrite(dirI1, 0);
        digitalWrite(dirI2, 1);
        for (int i = 0; i <= 200; i++) {
          analogWrite(pwmD, i);
          analogWrite(pwmI, i);
          contador = millis();
          while(millis()<contador +1.5){
            
          }
        }
        break;
      case 'L':
        digitalWrite(dirD1, 1);
        digitalWrite(dirD2, 0);
        digitalWrite(dirI1, 1);
        digitalWrite(dirI2, 0);
        for (int i = 0; i <= 200; i++) {
          analogWrite(pwmD, i);
          analogWrite(pwmI, i);
          contador = millis();
          while(millis()<contador +1.5){
            
          }
        }
        break;
      case 'R':
        digitalWrite(dirD1, 0);
        digitalWrite(dirD2, 1);
        digitalWrite(dirI1, 0);
        digitalWrite(dirI2, 1);
        for (int i = 0; i <= 200; i++) {
          analogWrite(pwmD, i);
          analogWrite(pwmI, i);
          contador = millis();
          while(millis()<contador +1.5){
            
          }
        }
        break;
      case 'S':
        alto(200,30);
        break;
    }
  }
}
void cambiar_pantalla( String texto,  float variable, int mapa_de_bits){
  unsigned long contador = 0;
  contador = millis();
  if(millis() < (contador + 100)){
  if (texto.length() > (MAX_ITEM_LENGTH-5)){
    texto = "Reduce el texto";
  }
  u8g.firstPage();
  u8g.setFont(u8g_font_7x14B);
  String variable_c = String (variable);
  char variable_c1 [10];
  if (fabs(variable-(int)variable < 0.0001)){
    itoa(variable, variable_c1, 10);
  }
  do{
      if (mapa_de_bits != NULL){
        u8g.drawBitmapP( 14, 10, 96/8, 40, iconos[mapa_de_bits]);
      }
      u8g.setPrintPos(64-((texto.length()/2)*8+8), 60);
      u8g.print(texto);  
      if( variable != NULL and variable_c1 != NULL ){
         u8g.print(variable_c1);
      }
      else if (variable != NULL){
        u8g.print(variable_c);
      }
  }while(u8g.nextPage());
  }
}
void reset(){
    digitalWrite(buzzer_pin,HIGH);
    delay(200);
    item_selected = 0;
    current_screen = 0;
    digitalWrite(buzzer_pin,LOW);
    posicion_pot = 0;
    digitalWrite(led1, LOW);
    digitalWrite(led2, LOW);
    digitalWrite(led3, LOW);
    servoMotor.write(0);
    analogWrite(pwmD, 0);
    analogWrite(pwmI, 0);
    digitalWrite(dirD1, LOW);
    digitalWrite(dirD2, LOW);
    digitalWrite(dirI1, LOW);
    digitalWrite(dirI2, LOW);
    distancia = 0;
    duracion = 0;
    contador = 0;
    aux = true;
}
void menu() {
  if(analogRead(botA1)>500){
    BUTTON_DOWN_PIN=1;
  }
  if(!(analogRead(botA1)>500)){
    BUTTON_DOWN_PIN=0;
  }
  if(analogRead(BUTTON_SELECT_PIN)>500){
    button_select_clicked = 0;
  }
  if(!(analogRead(BUTTON_SELECT_PIN)>500)){
    button_select_clicked = 1;
  }
}
void potenciometro(){
  unsigned long contador = 0;
  posicion_pot=analogRead(pot); 
  cambiar_pantalla("Posicion: ",posicion_pot,5);
  Serial.println(posicion_pot);
  contador= millis();
  while(millis() < contador + 500){
  }
}
void encender_led (int tiempo, int PIN){
  unsigned long contador = 0;
  contador = millis();
  analogWrite(PIN,1022);
  while(1){
    if (millis()<(contador+tiempo)){
      float tiempo_restante =  (tiempo - (millis() - contador));
      tiempo_restante = tiempo_restante/1000;
      cambiar_pantalla("Tiempo(s): ",tiempo_restante,4);
    }
    else{
      break;
    }
  }
}
void apagar_led (int tiempo, int PIN){
  unsigned long contador = 0;
  contador = millis();
  analogWrite(PIN,0);
  while(1){
    if (millis()<(contador+tiempo)){
      float tiempo_restante =  (tiempo - (millis() - contador));
      tiempo_restante = tiempo_restante/1000;
      cambiar_pantalla("Tiempo(s): ",tiempo_restante,4);
    }
    else{
      break;
    }
  }
}
void encender_buzzer ( int nota, int tiempo){
  unsigned long contador = 0;
  contador = millis();
  tone(buzzer_pin,notas[nota],tiempo);
  cambiar_pantalla("Frecuencia: ",notas[nota],3);
  while(1){
    if (millis()<(contador+(tiempo)+200)){
    }
    else{
      break;
    }
  }
  noTone(buzzer_pin);
}
void apagar_buzzer (int tiempo){
  unsigned long contador = 0;
  contador = millis();
  digitalWrite(buzzer_pin, LOW);
  while(1){
    if (millis()<(contador+tiempo)){
    }
    else{
      break;
    }
  }
}
void atras(int tiempo, int velomotor) {
  digitalWrite(dirD1, 1);
  digitalWrite(dirD2, 0);
  digitalWrite(dirI1, 0);
  digitalWrite(dirI2, 1);
      for (int i = 0; i <= velomotor; i++) {
    analogWrite(pwmD, i);
    analogWrite(pwmI, i);
    contador = millis();
    while(millis() < contador + 1.5){
    }
      }
  cambiar_pantalla("Velocidad: ",velomotor,2);
  contador = millis();
  while(millis() < contador + tiempo){
    
  }

}

void adelante(int tiempo, int velomotor, String siguiente) {

  digitalWrite(dirD1, 0);
  digitalWrite(dirD2, 1);
  digitalWrite(dirI1, 1);
  digitalWrite(dirI2, 0);
    for (int i = 0; i <= velomotor; i++) {
    analogWrite(pwmD, i);
    analogWrite(pwmI, i);
    contador = millis();
    while(millis() < contador + 1.5){
    }
  }
  contador = millis();
  // cambiar_pantalla("Velocidad: ",velomotor,2);
  while(millis() < contador + tiempo){
    sensor_proximidad(10,15,25,siguiente);
  }
  digitalWrite(buzzer_pin, LOW);
}
void derecha(int grados) {
  digitalWrite(dirD1, 0);
  digitalWrite(dirD2, 1);
  digitalWrite(dirI1, 0);
  digitalWrite(dirI2, 1);
  for (int i = 0; i <= vel; i++) {
    analogWrite(pwmD, i);
    analogWrite(pwmI, i);
    contador = millis();
    while(millis() < contador + 1.5){
    }
      }
  float tiempo = 0;
  contador = micros();
  if (grados > 270){
    tiempo = ((grados * 100000)/36) + (((grados - 270) % 10) * 4000);

  }
  else{
    tiempo = (grados * 100000)/35;
  }
  cambiar_pantalla("Grados: ",grados,5);
  while (micros()<(contador+tiempo)){
  }
}
void izquierda(int grados) {
  digitalWrite(dirD1, 1);
  digitalWrite(dirD2, 0);
  digitalWrite(dirI1, 1);
  digitalWrite(dirI2, 0);
  for (int i = 0; i <= vel; i++) {
    analogWrite(pwmD, i);
    analogWrite(pwmI, i);
    contador = millis();
    while(millis() < contador + 1.5){
    }
      }
  float tiempo = 0;
  contador = micros();
  if (grados > 270){
    tiempo = ((grados * 100000)/36) + (((grados - 270) % 10) * 4000);

  }
  else{
    tiempo = (grados * 100000)/36;
  }
  cambiar_pantalla("Grados: ",grados,5);
  while (micros()<(contador+tiempo)){
  }
}
void alto(int tiempo, int velomotor) {
  digitalWrite(dirD1, 1);
  digitalWrite(dirD2, 1);
  digitalWrite(dirI1, 1);
  digitalWrite(dirI2, 1);
  for (int i = 0; i <= velomotor; i++) {
    analogWrite(pwmD, i);
    analogWrite(pwmI, i);
    contador = millis();
    while(millis() < contador + 1.5){
    }
      }
  contador = millis();
  cambiar_pantalla("Alto",NULL,0);
  while (millis()<(contador+tiempo)){
  }
  }
void mover_servomotor(){
    posicion_pot = analogRead(pot);
    angulo_servo = map(posicion_pot, 0, 1023, 0, 181);
    cambiar_pantalla("Angulo: ",angulo_servo,5);
    servoMotor.write(angulo_servo);
}
void sensor_proximidad(int limite1,int limite2, int limite3,String direccion){
  unsigned long contador = 0;
  uint32_t color = strip.Color(0,0,0);
  digitalWrite(trig, HIGH);
  if(millis() > (contador + 100) && (aux == true)){
    digitalWrite(trig, LOW);
    duracion = pulseIn(eco, HIGH);
    distancia = duracion * 0.034 / 2;
    if (distancia < 0){
      distancia = distancia * -1;
    }
    contador = millis();
    aux = false;
    cambiar_pantalla("Distancia(cm): ",distancia,1);
  }
  if(millis() > (contador + 200)){
    if (distancia<=limite1){
      analogWrite(led1,1022);
      analogWrite(led2,1022);
      analogWrite(led3,1022);
      digitalWrite(buzzer_pin,HIGH);
      Serial.println(direccion);
      alto(500,10);
       if(direccion == "D"){
      color = strip.Color(0,0,255);
    }
    if(direccion == "I"){
      color = strip.Color(0,255,0);
    }
    if(direccion == "A"){
      color = strip.Color(255,0,0);
    }
    for (int i = 0; i<4; i++){
      strip.setPixelColor(i,color);
      strip.show();
    }
      if(direccion == "D"){
        derecha(90);
      }
      if (direccion == "I"){
        izquierda(90);
      }
      if (direccion == "A"){
        atras(1000,200);
      }
      alto(100,10);
      aux = true;
      contador = 0;
    }
    if (distancia>limite1 && distancia<=limite2){
      analogWrite(led1,1022);
      analogWrite(led2,1022);
      analogWrite(led3,0);
      digitalWrite(buzzer_pin,LOW);
    }
    if (distancia>limite2 && distancia<=limite3){
      analogWrite(led1,1022);
      analogWrite(led2,0);
      analogWrite(led3,0);
      digitalWrite(buzzer_pin,LOW);
    }
    if (distancia>limite3){
      analogWrite(led1,0);
      analogWrite(led2,0);
      analogWrite(led3,0);
      digitalWrite(buzzer_pin,LOW);
    }
    aux = true;
    contador = 0;
  }
  }
void encender_neopixel (int tiempo1, int tiempo2, int tiempo3, int tiempo4){
  int tiempos [] = {tiempo1,tiempo2,tiempo3,tiempo4};
  int maximo = tiempos[0];
  for (int i = 1; i<4; i++){
      if (tiempos[i]> maximo){
        maximo = tiempos[i];
      }
  }
  unsigned long contador = 0;
  unsigned long contador1 = 0;
  unsigned long contador2 = 0;
  unsigned long contador3 = 0;
  unsigned long contador4 = 0;
  contador = millis();
  contador1 = millis();
  contador2 = millis();
  contador3 = millis();
  contador4 = millis();
  while(1){
      float tiempo_restante =  (maximo*2 - (millis() - contador));
      tiempo_restante = tiempo_restante/1000;
      if (tiempo_restante <= maximo*2/1000){
        cambiar_pantalla("Tiempo(s): ",tiempo_restante,4);
      }
    if (millis()<(contador1+tiempo1)){
      uint32_t color = strip.Color(rojos[0],verdes[0],azules[0]);
      strip.setPixelColor(0,color);
      strip.show();
    }
    if(millis()>(contador1+tiempo1)){
      strip.setPixelColor(0,0);
      strip.show();
      if(millis()>(contador1+tiempo1*2)){
        contador1=millis();
      }
    }
  if (millis()<(contador2+tiempo2)){
      uint32_t color = strip.Color(rojos[1],verdes[1],azules[1]);
      strip.setPixelColor(1,color);
      strip.show();
    }
    if(millis()>(contador2+tiempo2)){
      strip.setPixelColor(1,0);
      strip.show();
      if(millis()>(contador2+tiempo2*2)){
        contador2=millis();
      }
    }
    if (millis()<(contador3+tiempo3)){
      uint32_t color = strip.Color(rojos[2],verdes[2],azules[2]);
      strip.setPixelColor(2,color);
      strip.show();
    }
    if(millis()>(contador3+tiempo3)){
      strip.setPixelColor(2,0);
      strip.show();
      if(millis()>(contador3+tiempo3*2)){
        contador3=millis();
      }
    }
    if (millis()<(contador4+tiempo4)){
      uint32_t color = strip.Color(rojos[3],verdes[3],azules[3]);
      strip.setPixelColor(3,color);
      strip.show();
    }
    if(millis()>(contador4+tiempo4)){
      strip.setPixelColor(3,0);
      strip.show();
      if(millis()>(contador4+tiempo4*2)){
        contador4 = millis();
      }
    }
    if (millis()>(contador+maximo*2)){
       for (int i = 0; i<4; i++){
      uint32_t color = strip.Color(255,255,255);
      strip.setPixelColor(i,color);
      }
      strip.show();
      break;
    }
  }
}
void apagar_neopixel (int tiempo,int neopixel){
  unsigned long contador = 0;
  contador = millis();
  strip.setPixelColor(neopixel,0);
  strip.show();
  while(1){
    if (millis()<(contador+tiempo)){
    }
    else{
      break;
    }
  }
}
void loop() {
menu();
if (current_screen == 0) { // MENU SCREEN

          if ((BUTTON_DOWN_PIN == 0) && (button_down_clicked == 0)) { // down button clicked - jump to next menu item
            item_selected = item_selected + 1; // select next item
            button_down_clicked = 1; // set button to clicked to only perform the action once
            if (item_selected >= NUM_ITEMS) { // last item was selected, jump to first menu item
              item_selected = 0;
              }
          } 
          if((BUTTON_DOWN_PIN == 1) && (button_down_clicked == 1)) { // unclick
            button_down_clicked = 0;
          }

if ((digitalRead(BUTTON_SELECT_PIN) == LOW) && (button_select_clicked == 0)) { // select button clicked, jump between screens
      button_select_clicked = 1; // set button to clicked to only perform the action once
      if (current_screen == 0) {current_screen = 1;} // menu items screen --> screenshots screen
      //else if (current_screen == 1) {current_screen = 2;} // screenshots screen --> qr codes screen
      digitalWrite(buzzer_pin,HIGH);
      delay(100);
      digitalWrite(buzzer_pin,LOW);
    }

      }
if ((digitalRead(BUTTON_SELECT_PIN) == HIGH) && (button_select_clicked == 1)) { // unclick 
      button_select_clicked = 0;
    }

    // set correct values for the previous and next items
    item_sel_previous = item_selected - 1;
    if (item_sel_previous < 0) {item_sel_previous = NUM_ITEMS - 1;} // previous item would be below first = make it the last
    item_sel_next = item_selected + 1;  
    if (item_sel_next >= NUM_ITEMS) {item_sel_next = 0;} // next item would be after last = make it the first
u8g.firstPage(); // required for page drawing mode for u8g library
do {
      for (int i = 0; i<4; i++){
      uint32_t color = strip.Color(255,255,255);
      strip.setPixelColor(i,color);
      }
      strip.show();
      if (current_screen == 0) { // MENU SCREEN

        // selected item background
        u8g.drawBitmapP(0, 22, 128/8, 21, bitmap_item_sel_outline);

        // draw previous item as icon + label                                 SELECCION DE ARRIBA
        u8g.setFont(u8g_font_7x14);                                           //tamaño de letra
        u8g.drawStr(25, 15, menu_items[item_sel_previous]);                   //nombre de la seleccion    
        // draw selected item as icon + label in bold font                    SELECCION DE EN MEDIO
        u8g.setFont(u8g_font_7x14B);    
        u8g.drawStr(25, 15+20+2, menu_items[item_selected]);      

        // draw next item as icon + label                                     SELECCION DE ABAJO
        u8g.setFont(u8g_font_7x14);     
        u8g.drawStr(25, 15+20+20+2+2, menu_items[item_sel_next]);   

        // draw scrollbar background                                          LINEA PUNTEADA DEL SCROLL
        u8g.drawBitmapP(128-8, 0, 8/8, 64, bitmap_scrollbar_background);      

        // draw scrollbar handle                                              INDICADOR DEL SCROLL
        u8g.drawBox(125, 64/NUM_ITEMS * item_selected, 3, 64/NUM_ITEMS); 

        // draw upir logo                                                     LOGO DEL CREADOR
        //u8g.drawBitmapP(128-16-4, 64-4, 16/8, 4, upir_logo);               

      }
      else if (current_screen == 1) { // IMAGEN 2
          
          //u8g.drawBitmapP( 0, 0, 128/8, 64, bitmap_screenshots[item_selected]); // draw screenshot
          
          
          if(item_selected==0){  
            adelante(500,255,"N");
            atras(500,255);
            alto(1000,100);
            derecha(90);
            alto(1000,100);
            izquierda(90);
            alto(1000,100);
            encender_led(1000,led2);
            apagar_led(1000,led2);
            encender_neopixel(200,400,600,800);
            encender_buzzer(1,1000);
            apagar_buzzer(1000);
            potenciometro();
          }
          else if(item_selected==1){ 
            // adelante(5000,220,"D");
            // adelante(5000,220,"I");
            // adelante(5000,200,"A");
            mover_servomotor();

          }
          else if(item_selected==2){
            for (int i = 0; i<14; i++){
              encender_buzzer(musica[i],tiempos[i]);
            }
            
          }
          else if (item_selected==3){
           bluetooth();
          }

          
      }
} while ( u8g.nextPage() ); // required for page drawing mode with u8g library
}

